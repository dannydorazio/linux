## arch/m68k/configs/next_defconfig
```kconfig
CONFIG_LOCALVERSION="-next"
CONFIG_SYSVIPC=y
CONFIG_POSIX_MQUEUE=y
CONFIG_LOG_BUF_SHIFT=16
CONFIG_CGROUPS=y
CONFIG_CGROUP_PIDS=y
CONFIG_BLK_DEV_INITRD=y
CONFIG_CC_OPTIMIZE_FOR_SIZE=y
CONFIG_EXPERT=y
CONFIG_M68030=y
CONFIG_M68040=y
CONFIG_M68060=y
CONFIG_NEXT=y
CONFIG_PROC_HARDWARE=y
CONFIG_PARTITION_ADVANCED=y
CONFIG_PAGE_BLOCK_MAX_ORDER=6
CONFIG_NET=y
CONFIG_PACKET=y
CONFIG_UNIX=y
CONFIG_INET=y
CONFIG_IP_PNP=y
CONFIG_IP_PNP_DHCP=y
CONFIG_IP_PNP_BOOTP=y
CONFIG_DEVTMPFS=y
CONFIG_DEVTMPFS_MOUNT=y
CONFIG_SCSI=y
CONFIG_BLK_DEV_SD=y
CONFIG_SCSI_NEXT_ESP=y
CONFIG_NETDEVICES=y
CONFIG_NEXT_MB8795=y
CONFIG_INPUT_EVDEV=y
# CONFIG_KEYBOARD_ATKBD is not set
CONFIG_KEYBOARD_NEXT=y
# CONFIG_MOUSE_PS2 is not set
# CONFIG_SERIO is not set
# CONFIG_LEGACY_PTYS is not set
CONFIG_SERIAL_PMACZILOG=y
CONFIG_SERIAL_PMACZILOG_CONSOLE=y
CONFIG_DRM=y
CONFIG_DRM_FBDEV_EMULATION=y
CONFIG_DRM_NEXTDIMENSION=y
CONFIG_DRM_NEXTDISPLAY=y
CONFIG_FB_DEVICE=y
CONFIG_FRAMEBUFFER_CONSOLE_LEGACY_ACCELERATION=y
CONFIG_RTC_CLASS=y
CONFIG_RTC_DRV_GENERIC=y
CONFIG_EXT4_FS=y
CONFIG_EXT4_FS_POSIX_ACL=y
CONFIG_FANOTIFY=y
CONFIG_AUTOFS_FS=y
CONFIG_TMPFS=y
CONFIG_TMPFS_POSIX_ACL=y
CONFIG_NFS_FS=y
CONFIG_NFS_V2=y
CONFIG_ROOT_NFS=y
# CONFIG_NFS_DISABLE_UDP_SUPPORT is not set
CONFIG_PRINTK_TIME=y
CONFIG_MAGIC_SYSRQ=y
CONFIG_SOFTLOCKUP_DETECTOR=y
CONFIG_EARLY_PRINTK=y
```

## drivers/net/ethernet/next/Kconfig
```kconfig
# SPDX-License-Identifier: GPL-2.0-only
#
# NeXT device configuration
#

config NET_VENDOR_NEXT
	bool "NeXT devices"
	default y
	depends on NEXT
	help
	  If you have a network (Ethernet) card belonging to this class, say Y.

	  Note that the answer to this question doesn't directly affect the
	  kernel: saying N will just cause the configurator to skip all the
	  questions about NeXT devices. If you say Y, you will be asked for
	  your specific card in the following questions.

if NET_VENDOR_NEXT

config NEXT_MB8795
	tristate "NeXT MB8795 ethernet support"
	depends on NEXT
	help
	  This is the Fujitsu MB8795 ethernet controller built into the
	  non-Turbo NeXT computers (NeXT Computer, NeXTcube, NeXTstation and
	  NeXTstation Color), and its AT&T 7213 successor in the Turbo
	  models.

	  To compile this driver as a module, choose M here: the module
	  will be called mb8795.

endif # NET_VENDOR_NEXT
```
